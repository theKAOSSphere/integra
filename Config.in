## Config.in
```kconfig
config BR2_PACKAGE_INTEGRA
	bool "integra"
	help
	  Integra LV2 plugin.

	  https://github.com/theKAOSSphere/integra
```

## pulverize/Config.in
```kconfig
config BR2_PACKAGE_PULVERIZE
    bool "pulverize"
    help
      Pulverize LV2 plugin

      https://github.com/theKAOSSphere/integra#pulverize
```
